## firmware/sdkconfig.defaults
```kconfig
# Rust often needs a bit of an extra main task stack size compared to C (the default is 3K)
CONFIG_ESP_MAIN_TASK_STACK_SIZE=8192

CONFIG_ESP_SYSTEM_EVENT_TASK_STACK_SIZE=4096
CONFIG_FREERTOS_IDLE_TASK_STACKSIZE=4096
CONFIG_PTHREAD_TASK_STACK_SIZE_DEFAULT=4096

# Bluetooth — NimBLE (BLE-only, lighter than Bluedroid)
CONFIG_BT_ENABLED=y
CONFIG_BT_NIMBLE_ENABLED=y

# Console/logs go to USB-Serial-JTAG (the "USB JTAG/serial debug unit" port,
# same port espflash uses for flashing and monitoring).
# This frees UART0 (CH343 "USB Single Serial" port) for host data.
CONFIG_ESP_CONSOLE_USB_SERIAL_JTAG=y
```
